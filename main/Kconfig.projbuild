## main/Kconfig.projbuild
```kconfig
# put here your custom config value
menu "Main Project Configuration"
config COMMAND_TX_GPIO
    int "TX Pin"
	range 0 40
	default 4
    help
	GPIO used for uart TX

config COMMAND_RX_GPIO
    int "RX Pin"
	range 0 40
	default 5
    help
	GPIO used for uart RX

config LED_PIN
    int "neopixel gpio pin"
	default 13
    help
	the pin that the data line of the led strip is connected to

config LED_COUNT
    int "default number of leds"
	default 150
    help
	the number of led for each effect if not supplied directly in command

config FRAME_DELAY
    int "default frame delay (ms)"
	default 5
    help
	the number of miliseconds to wait between rendering each effect frame if not supplied directly in command

config DEFAULT_EFFECT_COMMAND
    string "default effect command"
	default "effect:rainbow"
    help
	the default effect launched after start

endmenu
```
